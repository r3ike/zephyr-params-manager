## CMakeLists.txt
```
cmake_minimum_required(VERSION 3.20.0)
find_package(Zephyr REQUIRED HINTS $ENV{ZEPHYR_BASE})
project(params_manager)

# Includi la directory src e la directory build (per param_defs.hpp)
target_include_directories(app PRIVATE src ${CMAKE_CURRENT_BINARY_DIR})

# Includi la libreria MAVLink
target_include_directories(app PRIVATE ${CMAKE_CURRENT_SOURCE_DIR})

# Aggiungi i file sorgente
target_sources(app PRIVATE
    src/main.cpp
    src/param_manager.cpp
    src/mavlink_handler.cpp
)

# Genera i file dei parametri da YAML
find_package(Python3 REQUIRED)

set(MODULES_DIR ${CMAKE_CURRENT_SOURCE_DIR}/src/modules)
set(GENERATOR_SCRIPT ${CMAKE_CURRENT_SOURCE_DIR}/scripts/generate_params.py)
set(PARAM_DEFS_HPP ${CMAKE_CURRENT_BINARY_DIR}/param_defs.hpp)
set(PARAM_DEFS_CPP ${CMAKE_CURRENT_BINARY_DIR}/param_defs.cpp)

add_custom_command(
    OUTPUT ${PARAM_DEFS_HPP} ${PARAM_DEFS_CPP}
    COMMAND ${Python3_EXECUTABLE} ${GENERATOR_SCRIPT} ${MODULES_DIR} ${CMAKE_CURRENT_BINARY_DIR}
    DEPENDS ${GENERATOR_SCRIPT} ${MODULES_DIR}
    COMMENT "Generazione parametri da tutti i module.yaml"
)

target_sources(app PRIVATE ${PARAM_DEFS_CPP})
#target_include_directories(app PRIVATE ${CMAKE_CURRENT_BINARY_DIR})
```

## prj.conf
```kconfig
# prj.conf per native_sim su Zephyr 4.4
CONFIG_CPP=y
CONFIG_STD_CPP17=y
CONFIG_REQUIRES_FULL_LIBCPP=y

CONFIG_CBPRINTF_FP_SUPPORT=y


# ------------------ Flash e Storage ------------------
# 1. Abilita il supporto hardware per la memoria flash
CONFIG_FLASH=y

# 2. Abilita il driver del simulatore di flash
CONFIG_FLASH_SIMULATOR=y

# 3. Abilita il layout delle pagine di flash (richiesto da FCB)
CONFIG_FLASH_PAGE_LAYOUT=y

# 4. Abilita la mappa della memoria flash (richiesto da FCB)
CONFIG_FLASH_MAP=y

# 5. Abilita il Flash Circular Buffer (FCB)
CONFIG_FCB=y

# ------------------ Settings Subsystem ------------------
# Abilita il Settings Subsystem
CONFIG_SETTINGS=y

# Seleziona esplicitamente FCB come backend per il Settings Subsystem
CONFIG_SETTINGS_FCB=y

# ------------------ Logging ------------------
CONFIG_LOG=y
CONFIG_LOG_PRINTK=y
CONFIG_LOG_MODE_IMMEDIATE=y
```

## src/main.cpp
```c
#include <zephyr/kernel.h>
#include <zephyr/logging/log.h>
#include "param_manager.hpp"
#include "mavlink_handler.hpp"

LOG_MODULE_REGISTER(main, LOG_LEVEL_DBG);

int main() {
    LOG_INF("Avvio sistema parametri...");
    autopilot::params::init();
    mavlink_task_init();
    
    while (true) {
        // Esempio di lettura parametri
        //autopilot::params::ParamFloat roll_p(autopilot::params::ID::ROLL_P);
        //autopilot::params::ParamBool ahrs(autopilot::params::ID::AHRS_ENABLE);
        //LOG_INF("ROLL_P = %f, AHRS = %d", roll_p.get(), ahrs.get());
        k_sleep(K_SECONDS(5));
    }
    return 0;
}
```

## src/mavlink_handler.cpp
```c
#include <zephyr/kernel.h>
#include <zephyr/logging/log.h>
LOG_MODULE_REGISTER(mavlink, LOG_LEVEL_DBG);

#include "mavlink_handler.hpp"
#include "param_manager.hpp"
#include <cstring>
#include <unistd.h>       // close()
#include <sys/socket.h>
#include <netinet/in.h>
#include <arpa/inet.h>

#include <mavlink/common/mavlink.h>


static int sock;

// Invia un messaggio MAVLink a un destinatario specifico
static void send_mavlink_message_to(const mavlink_message_t& msg, struct sockaddr_in* dest) {
    uint8_t buffer[MAVLINK_MAX_PACKET_LEN];
    int len = mavlink_msg_to_send_buffer(buffer, &msg);
    if (len > 0) {
        sendto(sock, buffer, len, 0, (struct sockaddr*)dest, sizeof(*dest));
    }
}

// Risponde alla richiesta della lista parametri
static void handle_param_request_list(struct sockaddr_in* client) {
    using namespace autopilot::params;
    for (uint16_t i = 0; i < static_cast<uint16_t>(ID::COUNT); ++i) {
        const Metadata& meta = g_param_metadata[i];
        mavlink_message_t msg;
        float value = 0;
        switch (meta.type) {
            case Metadata::INT32: value = static_cast<float>(*static_cast<int32_t*>(g_param_cache[i])); break;
            case Metadata::FLOAT: value = *static_cast<float*>(g_param_cache[i]); break;
            case Metadata::BOOL:  value = *static_cast<bool*>(g_param_cache[i]) ? 1.0f : 0.0f; break;
        }
        mavlink_msg_param_value_pack(
            1, MAV_COMP_ID_AUTOPILOT1, &msg,
            meta.name, value,
            (meta.type == Metadata::INT32) ? MAV_PARAM_TYPE_INT32 :
            (meta.type == Metadata::FLOAT) ? MAV_PARAM_TYPE_REAL32 :
            MAV_PARAM_TYPE_UINT8,
            static_cast<uint16_t>(ID::COUNT), i);
        send_mavlink_message_to(msg, client);
    }
}

// Gestisce la modifica di un parametro
static void handle_param_set(const mavlink_param_set_t& set, struct sockaddr_in* client) {
    using namespace autopilot::params;
    for (uint16_t i = 0; i < static_cast<uint16_t>(ID::COUNT); ++i) {
        if (strcmp(set.param_id, g_param_metadata[i].name) == 0) {
            bool ok = false;
            switch (g_param_metadata[i].type) {
                case Metadata::FLOAT: {
                    ParamFloat p(static_cast<ID>(i));
                    int ret = p.set(set.param_value);
                    if (ret) {
                        LOG_ERR("Salvataggio fallito (err %d)", ret);
                    }
                    ok = true;
                    break;
                }
                case Metadata::INT32: {
                    ParamInt p(static_cast<ID>(i));
                    p.set(static_cast<int32_t>(set.param_value));
                    ok = true;
                    break;
                }
                case Metadata::BOOL: {
                    ParamBool p(static_cast<ID>(i));
                    p.set(set.param_value != 0.0f);
                    ok = true;
                    break;
                }
            }
            if (ok) {
                mavlink_message_t msg;
                mavlink_msg_param_value_pack(
                    1, MAV_COMP_ID_AUTOPILOT1, &msg,
                    set.param_id, set.param_value,
                    set.param_type, 0, i);
                send_mavlink_message_to(msg, client);
                LOG_INF("Parametro %s impostato a %f", set.param_id, (double)set.param_value);
            }
            return;
        }
    }
}

// Invia un heartbeat a un destinatario specifico
static void send_heartbeat_to(struct sockaddr_in* dest) {
    mavlink_message_t msg;
    mavlink_msg_heartbeat_pack(
        1, MAV_COMP_ID_AUTOPILOT1, &msg,
        MAV_TYPE_QUADROTOR,
        MAV_AUTOPILOT_GENERIC,
        MAV_MODE_FLAG_MANUAL_INPUT_ENABLED,
        0,
        MAV_STATE_ACTIVE);
    send_mavlink_message_to(msg, dest);
}

static void send_autopilot_version(struct sockaddr_in* dest) {
    mavlink_message_t msg;
    mavlink_msg_autopilot_version_pack(
        1, MAV_COMP_ID_AUTOPILOT1, &msg,
        MAV_AUTOPILOT_GENERIC,        // autopilot type
        0, 0, 0, 0,                     // versioni varie
        0, 0, 0, 0, 0, 0, 0);          // altre info
    send_mavlink_message_to(msg, dest);
}

static void send_sys_status_to(struct sockaddr_in* dest) {
    mavlink_message_t msg;

    // --- Sensori di base (come prima) ---
    uint32_t onboard_control_sensors_present =
        MAV_SYS_STATUS_SENSOR_3D_GYRO |
        MAV_SYS_STATUS_SENSOR_3D_ACCEL |
        MAV_SYS_STATUS_SENSOR_3D_MAG |
        MAV_SYS_STATUS_SENSOR_ABSOLUTE_PRESSURE |
        MAV_SYS_STATUS_SENSOR_GPS;

    uint32_t onboard_control_sensors_enabled = onboard_control_sensors_present;
    uint32_t onboard_control_sensors_health = onboard_control_sensors_present; // tutti OK

    // --- Sensori estesi (MAVLink 2) ---
    // Se non hai sensori aggiuntivi (es. lidar, flusso ottico), metti 0.
    uint32_t onboard_control_sensors_present_extended = 0;
    uint32_t onboard_control_sensors_enabled_extended = 0;
    uint32_t onboard_control_sensors_health_extended = 0;

    // --- Altri parametri ---
    uint16_t load = 0;              // carico CPU in centesimi (0 = non disponibile)
    uint16_t voltage_battery = 0;   // mV (0 = non disponibile)
    int16_t  current_battery = -1;  // mA (-1 = non disponibile)
    int8_t   battery_remaining = -1;// percentuale (-1 = non disponibile)

    uint16_t drop_rate_comm = 0;
    uint16_t errors_comm = 0;
    uint16_t errors_count1 = 0;
    uint16_t errors_count2 = 0;
    uint16_t errors_count3 = 0;
    uint16_t errors_count4 = 0;

    // --- Pacchettizzazione con TUTTI i campi ---
    mavlink_msg_sys_status_pack(
        1,                          // system_id
        MAV_COMP_ID_AUTOPILOT1,    // component_id
        &msg,
        onboard_control_sensors_present,
        onboard_control_sensors_enabled,
        onboard_control_sensors_health,
        load,
        voltage_battery,
        current_battery,
        battery_remaining,
        drop_rate_comm,
        errors_comm,
        errors_count1,
        errors_count2,
        errors_count3,
        errors_count4,
        onboard_control_sensors_present_extended,   // nuovo!
        onboard_control_sensors_enabled_extended,   // nuovo!
        onboard_control_sensors_health_extended     // nuovo!
    );

    send_mavlink_message_to(msg, dest);
}

static void mavlink_thread(void *, void *, void *) {
    sock = socket(AF_INET, SOCK_DGRAM, 0);
    if (sock < 0) {
        LOG_ERR("socket() fallita: %d", sock);
        return;
    }

    struct sockaddr_in addr;
    memset(&addr, 0, sizeof(addr));
    addr.sin_family = AF_INET;
    addr.sin_port = htons(0);  // porta effimera
    addr.sin_addr.s_addr = INADDR_ANY;

    if (bind(sock, (struct sockaddr*)&addr, sizeof(addr)) < 0) {
        LOG_ERR("bind() fallita");
        close(sock);
        return;
    }

    // Destinazione fissa per gli heartbeat (il client Python ascolterà su 14551)
    struct sockaddr_in heartbeat_dest;
    memset(&heartbeat_dest, 0, sizeof(heartbeat_dest));
    heartbeat_dest.sin_family = AF_INET;
    heartbeat_dest.sin_port = htons(14550);  // QGC default
    inet_pton(AF_INET, "127.0.0.1", &heartbeat_dest.sin_addr);

    uint8_t buf[MAVLINK_MAX_PACKET_LEN];
    uint64_t last_heartbeat = 0;

    while (true) {
        uint64_t now = k_uptime_get();

        // Invia heartbeat periodico alla destinazione fissa
        if (now - last_heartbeat >= 1000) {
            send_heartbeat_to(&heartbeat_dest);
            send_autopilot_version(&heartbeat_dest);
            send_sys_status_to(&heartbeat_dest); 
            last_heartbeat = now;
        }

        // Ricezione dati (non bloccante)
        struct sockaddr_in recv_addr;
        socklen_t recv_len = sizeof(recv_addr);
        ssize_t n = recvfrom(sock, buf, sizeof(buf), MSG_DONTWAIT, (struct sockaddr*)&recv_addr, &recv_len);
        if (n > 0) {
            // Aggiorniamo la destinazione dell'heartbeat con l'ultimo mittente (opzionale)
            //memcpy(&heartbeat_dest, &recv_addr, sizeof(recv_addr));

            mavlink_message_t msg;
            mavlink_status_t status;
            for (int i = 0; i < n; ++i) {
                if (mavlink_parse_char(MAVLINK_COMM_0, buf[i], &msg, &status)) {
                    switch (msg.msgid) {
                        case MAVLINK_MSG_ID_PARAM_REQUEST_LIST:
                            printk("Received PARAM_REQUEST_LIST\n");
                            handle_param_request_list(&recv_addr);
                            break;
                        case MAVLINK_MSG_ID_PARAM_SET: {
                            mavlink_param_set_t set;
                            printk("Received PARAM_SET\n");
                            mavlink_msg_param_set_decode(&msg, &set);
                            handle_param_set(set, &recv_addr);
                            break;
                        }
                        default:
                            break;
                    }
                }
            }
        }
        k_sleep(K_MSEC(10));
    }
}

K_THREAD_DEFINE(mavlink_tid, 2048, mavlink_thread, NULL, NULL, NULL, 7, 0, 0);

void mavlink_task_init() {}
```

## src/mavlink_handler.hpp
```c
#pragma once
#include <zephyr/net/socket.h>

void mavlink_task_init(void);
```

## src/module_params.hpp
```c
// module_params.hpp
#pragma once
#include "param_manager.hpp"
#include <vector>

namespace autopilot {

// Classe base astratta per tutti i moduli che hanno parametri
class ModuleParams {
public:
    // Distruttore virtuale (buona pratica per classi base)
    virtual ~ModuleParams() = default;

    // Metodo virtuale che può essere chiamato periodicamente (es. nel loop principale)
    // per aggiornare tutti i parametri registrati dal modulo.
    // Di default, chiama load() su ogni parametro nella lista.
    virtual void updateParams() {
        for (auto param : _param_list) {
            if (param) {
                param->load();
            }
        }
    }

protected:
    // Metodo per registrare un parametro.
    // Deve essere chiamato dai costruttori delle classi derivate.
    void registerParam(ParamBase* param) {
        if (param) {
            _param_list.push_back(param);
        }
    }

private:
    // Lista di puntatori ai parametri appartenenti a questo modulo.
    // Usiamo std::vector per semplicità; in produzione potremmo usare
    // un array statico per evitare allocazioni dinamiche.
    std::vector<ParamBase*> _param_list;
};

} // namespace autopilot
```

## src/param_manager.cpp
```c
// param_manager.cpp
#include <zephyr/logging/log.h>
LOG_MODULE_REGISTER(params_manager, LOG_LEVEL_DBG);
#include "param_manager.hpp"
#include <zephyr/kernel.h>
#include <zephyr/sys/__assert.h>
#include <cstring>

namespace autopilot::params {

// ------------------------------------------------------------
// DEFINIZIONE DELLA CACHE
// ------------------------------------------------------------
// Allochiamo staticamente un buffer di byte sufficiente a contenere
// il valore di TUTTI i parametri. Usiamo uint64_t per garantire
// allineamento per qualsiasi tipo (float, int32_t, bool).
// L'attributo __aligned(4) assicura che l'accesso a 32 bit sia efficiente.
static uint8_t __aligned(4) param_cache_storage[
    static_cast<uint16_t>(ID::COUNT) * sizeof(uint64_t)
];

// Array di puntatori alla cache. Ogni elemento punta all'inizio
// della porzione di buffer riservata a quel parametro.
void* g_param_cache[static_cast<uint16_t>(ID::COUNT)];

// ------------------------------------------------------------
// FUNZIONE DI INIZIALIZZAZIONE CACHE CON VALORI DI DEFAULT
// ------------------------------------------------------------
static void init_cache_with_defaults() {
    for (uint16_t i = 0; i < static_cast<uint16_t>(ID::COUNT); ++i) {
        const Metadata& meta = g_param_metadata[i];
        // Calcola l'indirizzo nel buffer per questo parametro
        void* ptr = &param_cache_storage[i * sizeof(uint64_t)];
        g_param_cache[i] = ptr;
        
        // In base al tipo, copia il valore di default
        switch (meta.type) {
            case Metadata::INT32:
                *static_cast<int32_t*>(ptr) = meta.i32_default;
                break;
            case Metadata::FLOAT:
                *static_cast<float*>(ptr) = meta.f_default;
                break;
            case Metadata::BOOL:
                *static_cast<bool*>(ptr) = meta.b_default;
                break;
        }
    }
}

// ------------------------------------------------------------
// CALLBACK DEL SETTINGS SUBSYSTEM
// ------------------------------------------------------------
// Questa funzione viene chiamata da Zephyr quando deve caricare
// un valore dalla Flash. Viene invocata da settings_load() o
// settings_load_subtree().
static int settings_handler(const char *key, size_t len,
                            settings_read_cb read_cb, void *cb_arg)
{
    // La chiave è nel formato "params/NOME_PARAMETRO"
    // Saltiamo i primi 7 caratteri ("params/") per ottenere il nome
    LOG_INF("Caricamento chiave: %s", key);
    //const char *name = key + 7;

    //printk("Settings handler: key=%s, name=%s\n", key, name);
    
    // Cerchiamo il parametro per nome nella tabella metadati
    for (uint16_t i = 0; i < static_cast<uint16_t>(ID::COUNT); ++i) {
        if (strcmp(key, g_param_metadata[i].name) == 0) {
            // Trovato! Otteniamo il puntatore alla cache
            void* cache_ptr = g_param_cache[i];
            
            // Determiniamo la dimensione attesa in base al tipo
            size_t expected_size = 0;
            switch (g_param_metadata[i].type) {
                case Metadata::INT32: expected_size = sizeof(int32_t); break;
                case Metadata::FLOAT: expected_size = sizeof(float);   break;
                case Metadata::BOOL:  expected_size = sizeof(bool);    break;
            }
            
            // Leggiamo il valore dalla Flash usando il callback fornito da Zephyr
            ssize_t ret = read_cb(cb_arg, cache_ptr, expected_size);
            
            // Se la lettura ha successo, restituiamo 0, altrimenti errore
            return (ret == expected_size) ? 0 : -EINVAL;
        }
    }
    // Parametro non trovato
    return -ENOENT;
}

// ------------------------------------------------------------
// REGISTRAZIONE DELL'HANDLER CON ZEPHYR
// ------------------------------------------------------------
// Macro che definisce un handler statico per il sottosistema "params".
// Il primo argomento è il nome dell'handler (arbitrario).
// Il secondo è il prefisso delle chiavi che gestiamo ("params").
// Il terzo (NULL) è una callback per il commit (non ci serve).
// Il quarto è la nostra callback di lettura.
// Gli ultimi due sono per il supporto alla registrazione dinamica (non usati).
SETTINGS_STATIC_HANDLER_DEFINE(params, "params", NULL, settings_handler, NULL, NULL);

// ------------------------------------------------------------
// FUNZIONE DI INIZIALIZZAZIONE GLOBALE
// ------------------------------------------------------------
void init() {
    // 1. Inizializza la cache RAM con i valori di default presi dai metadati
    init_cache_with_defaults();
    
    // 2. Inizializza il sottosistema Settings di Zephyr
    //    (se non già fatto altrove, ma chiamarlo più volte è innocuo)
    settings_subsys_init();
    
    // 3. Carica tutti i valori salvati in Flash.
    //    Per ogni chiave "params/*" trovata, verrà chiamata la nostra
    //    settings_handler, che sovrascriverà il valore di default nella cache.
    settings_load();
}

} // namespace autopilot::params
```

## src/param_manager.hpp
```c
// param.hpp
#pragma once
#include <cstdio>
#include <zephyr/kernel.h>
#include <zephyr/settings/settings.h>
#include "param_defs.hpp"

namespace autopilot::params {



// ------------------------------------------------------------
// DICHIARAZIONI ESTERNE (definite in param_manager.cpp)
// ------------------------------------------------------------
// Funzione helper: dato un ID restituisce il nome stringa.
// Implementata semplicemente come:
//   return g_param_metadata[static_cast<uint16_t>(id)].name;
inline const char* id_to_key(ID id) {
    return g_param_metadata[static_cast<uint16_t>(id)].name;
}

// Cache globale: un array di puntatori void*.
// Ogni puntatore punta a una locazione di RAM dove è memorizzato
// il valore corrente del parametro.
// La cache è indicizzata tramite cast dell'ID a uint16_t.
extern void* g_param_cache[];

// Aggiungere in param.hpp prima di template<typename T> class Param
class ParamBase {
public:
    virtual int load() = 0;
    virtual ~ParamBase() = default;
};

void init();


// ------------------------------------------------------------
// CLASSE TEMPLATE Param<T>
// ------------------------------------------------------------
template<typename T>
class Param : public ParamBase{
public:
    // Costruttore: riceve l'ID del parametro.
    // Chiama subito load() per assicurarsi che il valore sia caricato
    // dalla Flash (o impostato al default) prima di qualsiasi utilizzo.
    explicit Param(ID id) : _id(id) {
        load();
    }

    // METODO get(): restituisce una copia del valore corrente.
    // Legge direttamente dalla cache RAM (accesso veloce).
    T get() const {
        // Recupera il puntatore dalla cache globale usando l'ID come indice.
        // Il cast a T* è sicuro perché il tipo T è garantito dal template.
        return *static_cast<T*>(g_param_cache[static_cast<uint16_t>(_id)]);
    }

    // METODO set(): scrive un nuovo valore.
    // 1. Aggiorna immediatamente la cache RAM.
    // 2. Salva il valore nella memoria non volatile (Flash) tramite Zephyr Settings.
    int set(const T& value) {
        // Ottiene il puntatore alla locazione di cache
        T* cache_ptr = static_cast<T*>(g_param_cache[static_cast<uint16_t>(_id)]);
        // Scrive il nuovo valore in RAM
        *cache_ptr = value;
        char full_key[64];
        snprintf(full_key, sizeof(full_key), "params/%s", id_to_key(_id));
        // Salva in Flash usando come chiave il nome del parametro
        // Il valore viene scritto così com'è in binario (sizeof(T) byte)
        int ret = settings_save_one(full_key, cache_ptr, sizeof(T));
        
        return ret;
    }

    // METODO load(): forza la ricarica del valore dalla Flash.
    // Chiama settings_load_subtree() che attiva la callback del
    // Settings Subsystem per il nostro parametro specifico.
    int load() override{
        // Carica solo il sottoalbero relativo a questo parametro.
        // La chiave passata è il nome del parametro (es. "ROLL_P").
        return settings_load_subtree(id_to_key(_id));
    }

    // OPERATORE DI CAST IMPLICITO a T
    // Permette di usare un oggetto Param<T> come se fosse una variabile di tipo T.
    // Esempio: float gain = _roll_p;  // chiama automaticamente get()
    operator T() const { return get(); }

    // OPERATORE DI ASSEGNAMENTO
    // Permette di assegnare un valore direttamente all'oggetto Param.
    // Esempio: _roll_p = 2.5f;  // chiama automaticamente set()
    Param& operator=(const T& value) {
        set(value);
        return *this;
    }

private:
    ID _id;   // Identificativo del parametro
};

// ALIAS per una sintassi più familiare (simile a PX4)
using ParamInt   = Param<int32_t>;
using ParamFloat = Param<float>;
using ParamBool  = Param<bool>;

} // namespace autopilot::params
```
